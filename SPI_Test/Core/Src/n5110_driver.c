#include "main.h"
#include "n5110_driver.h"



/* configure pins for screen communication  */
#define LED LED_Pin
#define LED_PORT GPIOB

#define DC DC_Pin
#define DC_PORT GPIOA

#define RST RST_Pin
#define RST_PORT GPIOA

#define SCE SCE_Pin
#define SCE_PORT GPIOA

#define VCC VCC_Pin
#define VCC_PORT GPIOB



// Font 7x5 Bitmap (ASCII)
char FONT_7x5[96][5] = {
 {0b00000000,0b00000000,0b00000000,0b00000000,0b00000000}, // space
 {0b00000000,0b00000000,0b01001111,0b00000000,0b00000000}, // !
 {0b00000000,0b00000111,0b00000000,0b00000111,0b00000000}, // "
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 {0b00001000,0b00000100,0b00000100,0b00001000,0b00000100}  // ~
};

static uint8_t screen_buffer[SCREEN_WIDTH][SCREEN_HEIGHT/8]; //screen buffer

//initialize display
void init_n5110() {

	HAL_GPIO_WritePin(SCE_PORT, SCE, 1); //set SCE to high to make sure display driver doesnt accept input
	HAL_GPIO_WritePin(VCC_PORT, VCC, 1); //turn on display driver

	//briefly set rst pint to 0 to reset display driver
	HAL_GPIO_WritePin(RST_PORT, RST, 1);
	HAL_Delay(10);
	HAL_GPIO_WritePin(RST_PORT, RST, 0);
	HAL_Delay(10);
	HAL_GPIO_WritePin(RST_PORT, RST, 1);
	HAL_Delay(10);

	//test display led
	HAL_GPIO_WritePin(LED_PORT, LED, 1);

	uint8_t init_display_instructions[] = {0b00100001,	//function set PD=0, V=0, H=1 (extended instruction set)
										   0b11010000,	//set Vop to +80 * b[V]
										   0b00100000,	//function set PD=0, V=0, H=0 (normal instruction set)
										   0b00001100}; //display control set normal mode (D=1, E=0)

	spi_tx_byte(init_display_instructions[0], COMMAND);
	spi_tx_byte(init_display_instructions[1], COMMAND);
	spi_tx_byte(init_display_instructions[2], COMMAND);
	spi_tx_byte(init_display_instructions[3], COMMAND);

	return;
}


//write a byte to display
void spi_tx_byte(uint8_t byte, int dc) {
	if(dc == DATA)
		HAL_GPIO_WritePin(DC_PORT, DC, 1); //set DC to high to specify data
	else if(dc == COMMAND)
		HAL_GPIO_WritePin(DC_PORT, DC, 0); //set DC to low to specifiy command
	else
		return;


	HAL_GPIO_WritePin(SCE_PORT, SCE, 0);
	HAL_SPI_Transmit(&hspi1, &byte, 1, 10);
	HAL_GPIO_WritePin(SCE_PORT, SCE, 1);
	return;
}

//clears screen, does not move cursor
void clear_screen() {
	for(int i = 0; i < (48*84); i++) {
		spi_tx_byte(0, DATA);
	}
	return;
}

//write the full screen buffer to display, optimized for speed
void write_screen_buffer() {
	set_draw_coordinates(0,0);

	HAL_GPIO_WritePin(DC_PORT, DC, 1); //set DC to high to specify data

	HAL_GPIO_WritePin(SCE_PORT, SCE, 0);
	
	HAL_SPI_Transmit(&hspi1, &screen_buffer, sizeof(screen_buffer), 10);

	HAL_GPIO_WritePin(SCE_PORT, SCE, 1);

}

void write_char(char character) {
	int column;
	for(column = 0; column < 5; column++) {
		spi_tx_byte(FONT_7x5[character-32][column], DATA);
	}
	spi_tx_byte(0, DATA); //add empty column for spacing between characters
	return;
}


//move the draw cursor to x,y with 0<=x<=83 and 0<=y<=5
//every y increment represents 8 pixels, thus y=5 means that the cursor is on the bottom row of 8 pixels high
void set_draw_coordinates(int x, int y) {
	if(x<0 || x>83 || y<0 || y>5) {
		return;
	}
	uint8_t x_command = 0b10000000;
	uint8_t y_command = 0b01000000;
	x_command += x;
	y_command += y;
	spi_tx_byte(x_command, COMMAND);
	spi_tx_byte(y_command, COMMAND);
}
